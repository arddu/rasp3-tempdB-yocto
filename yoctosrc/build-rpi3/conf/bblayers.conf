## yoctosrc/build-rpi3/conf/bblayers.conf
```bitbake
# POKY_BBLAYERS_CONF_VERSION is increased each time build/conf/bblayers.conf
# changes incompatibly
POKY_BBLAYERS_CONF_VERSION = "2"

BBPATH = "${TOPDIR}"
BBFILES ?= ""

BBLAYERS ?= " \
  /home/dellz/yocto-course/sources/poky/meta \
  /home/dellz/yocto-course/sources/poky/meta-poky \
  /home/dellz/yocto-course/sources/poky/meta-yocto-bsp \
  /home/dellz/yocto-course/sources/meta-openembedded/meta-oe \
  /home/dellz/yocto-course/sources/meta-openembedded/meta-python \
  /home/dellz/yocto-course/sources/meta-openembedded/meta-networking \
  /home/dellz/yocto-course/sources/meta-raspberrypi \
  /home/dellz/yocto-course/sources/meta-student \
  /home/dellz/yocto-course/sources/meta-studentproject \
  "
```
